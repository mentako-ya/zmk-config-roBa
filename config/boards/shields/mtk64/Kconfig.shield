## config/boards/shields/mtk64/Kconfig.shield
```kconfig
# No whitespace after the comma or in the keyboard name!
config SHIELD_MTK64_DONGLE
    def_bool $(shields_list_contains,mtk64_DONGLE)
    
config SHIELD_MTK64_R
    def_bool $(shields_list_contains,mtk64_R)

config SHIELD_MTK64_L
    def_bool $(shields_list_contains,mtk64_L)

config SHIELD_MTK64_FOOT
    def_bool $(shields_list_contains,mtk64_FOOT)
```
